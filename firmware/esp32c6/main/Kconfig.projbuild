## firmware/esp32c6/main/Kconfig.projbuild
```kconfig
menu "Petro protection (PETRO-5)"

    config PETRO_OVERTEMP_C
        int "Over-temperature trip on the NTC (C)"
        range 40 70
        default 55
        help
            The NTC (TH1, beside the relay) reading at which Petro trips, held for 2 s. The NTC
            under-reads the hot spots, so this is set from Gate 4's ratio
            (docs/testing/gate-4-load-thermal.md 5):
                limit = room + (70 - room) / ratio, room = 35 C.
            55 C (a ratio of 1.75) is provisional until Gate 4 has run. A trip can't be cleared
            while the NTC is within 5 C of this.

    config PETRO_ZX_SWITCHING
        bool "Switch the relay at the mains' zero crossings"
        default y
        help
            Time the relay's close and open to the BL0939's ZX output, allowing for the relay's
            operate and release times. Without ZX edges for 100 ms (no mains: on USB) it switches
            at once. Trips always switch at once.

    config PETRO_RELAY_OPERATE_US
        int "Relay operate time (us)"
        depends on PETRO_ZX_SWITCHING
        range 0 20000
        default 8000
        help
            From the coil energised to the contacts closed. HF115F: about 8 ms (the datasheet's
            maximum is 15 ms). Measure it at Gate 2 and set it here.

    config PETRO_RELAY_RELEASE_US
        int "Relay release time (us)"
        depends on PETRO_ZX_SWITCHING
        range 0 20000
        default 4000
        help
            From the coil de-energised to the contacts open. HF115F: about 4 ms, longer with a
            plain flyback diode. Measure it at Gate 2 and set it here.

endmenu
```

## tools/thermal-logger/main/Kconfig.projbuild
```kconfig
menu "Zatt thermal logger"

    config ZATT_I2C_SDA_GPIO
        int "I2C SDA GPIO"
        default 8 if IDF_TARGET_ESP32S3
        default 21 if IDF_TARGET_ESP32
        default 4
        help
            S3-DevKitC-1: GPIO8 (its default I2C SDA, not used by the board).

    config ZATT_I2C_SCL_GPIO
        int "I2C SCL GPIO"
        default 9 if IDF_TARGET_ESP32S3
        default 22 if IDF_TARGET_ESP32
        default 5

    config ZATT_I2C_FREQ_HZ
        int "I2C clock (Hz)"
        default 400000
        range 100000 1000000
        help
            400000 is safe on jumper wires. The MLX90640 allows 1000000; try it with short wires and
            4k7 or lower pull-ups. At 2 Hz refresh, 400 kHz is plenty.

    config ZATT_EMISSIVITY_PERCENT
        int "Emissivity (%)"
        default 95
        range 10 100
        help
            0.95 suits the Kapton tape and marker dots the Gate 4 spots are marked with.

    config ZATT_REFLECTED_SHIFT_C
        int "Reflected temperature = sensor Ta minus this (degC)"
        default 8
        help
            Melexis' recommended TA_SHIFT for the 55 degree part.

    config ZATT_PUSH_INTERVAL_S
        int "Seconds between metric pushes"
        default 10
        range 2 3600

    config ZATT_HTTP_PORT
        int "Mapping page HTTP port"
        default 80

    config ZATT_BATTERY_ADC
        bool "Measure the battery on an ADC pin"
        default n
        help
            Needs a resistor divider from the battery to the pin (see the README). Off by default:
            without it zatt_battery_volts is not sent.

    config ZATT_BATTERY_GPIO
        int "Battery ADC GPIO"
        depends on ZATT_BATTERY_ADC
        default 1 if IDF_TARGET_ESP32S3
        default 34 if IDF_TARGET_ESP32
        default 0
        help
            S3: GPIO1 is ADC1_CH0. Must be an ADC1 pin (ADC2 clashes with Wi-Fi).

    config ZATT_BATTERY_DIVIDER_PERCENT
        int "Battery divider ratio (percent): battery volts / pin volts x 100"
        depends on ZATT_BATTERY_ADC
        default 200
        help
            200 for two equal resistors (for example 100k + 100k), which keeps a 4.2 V cell at 2.1 V.

    menu "Default spot rectangles (used until saved from the mapping page)"
        comment "Format x0,y0,x1,y1 inclusive, pixel (0,0) top left; empty means disabled"

        config ZATT_SPOT_T1_DEFAULT
            string "T1: J1, the live screw's head"
            default ""
        config ZATT_SPOT_T2_DEFAULT
            string "T2: J2, the live screw's head"
            default ""
        config ZATT_SPOT_T3_DEFAULT
            string "T3: F1's clip on the live input side"
            default ""
        config ZATT_SPOT_T4_DEFAULT
            string "T4: K1, the top of its case above the contacts"
            default ""
        config ZATT_SPOT_T5_DEFAULT
            string "T5: RS1 (the shunt), and the pour beside it"
            default ""
        config ZATT_SPOT_T6_DEFAULT
            string "T6: the L_F pour between F1 and K1"
            default ""
        config ZATT_SPOT_T7_DEFAULT
            string "T7: R1 (the fusible resistor)"
            default ""
    endmenu

endmenu
```

## tools/thermal-logger/sdkconfig.defaults
```kconfig
CONFIG_ESPTOOLPY_FLASHSIZE_4MB=y
CONFIG_PARTITION_TABLE_CUSTOM=y
CONFIG_PARTITION_TABLE_CUSTOM_FILENAME="partitions.csv"
CONFIG_PARTITION_TABLE_FILENAME="partitions.csv"
CONFIG_COMPILER_OPTIMIZATION_SIZE=y
CONFIG_HTTPD_MAX_REQ_HDR_LEN=1024
CONFIG_ESP_MAIN_TASK_STACK_SIZE=6144
```
